## sdkconfig.defaults
```kconfig
# ESP32-S3 Voice Companion - sdkconfig 默认配置
# 目标芯片: ESP32-S3

CONFIG_IDF_TARGET="esp32s3"
CONFIG_IDF_TARGET_ESP32S3=y

# PSRAM 配置 — ESP32-S3R8 板载 OPI (Octal) 8MB PSRAM
CONFIG_SPIRAM=y
CONFIG_SPIRAM_MODE_OCT=y
CONFIG_SPIRAM_SPEED_80M=y
CONFIG_SPIRAM_BOOT_INIT=y
CONFIG_SPIRAM_USE_MALLOC=y
CONFIG_SPIRAM_MEMTEST=y
CONFIG_SPIRAM_ALLOW_BSS_SEG_EXTERNAL_MEMORY=y

# CPU 频率
CONFIG_ESP32S3_CPU_FREQ_240=y
CONFIG_ESP32S3_CPU_FREQ_MAX=y

# WiFi 配置
CONFIG_ESP_WIFI_STATIC_RX_BUFFER_NUM=10
CONFIG_ESP_WIFI_DYNAMIC_RX_BUFFER_NUM=32
CONFIG_ESP_WIFI_DYNAMIC_TX_BUFFER_NUM=32
CONFIG_ESP_WIFI_AMPDU_TX_ENABLED=y
CONFIG_ESP_WIFI_AMPDU_RX_ENABLED=y
CONFIG_ESP_WIFI_SOFTAP_BEACON_100MS=y

# 蓝牙 (关闭，节省资源)
CONFIG_BT_ENABLED=n
CONFIG_BTDM_CTRL_MODE_BLE_ONLY=n
CONFIG_BTDM_CTRL_MODE_BR_EDR_ONLY=n
CONFIG_BTDM_CTRL_MODE_BTDM=n

# LVGL 配置
CONFIG_LVGL_TICK_PERIOD_MS=10
CONFIG_LVGL_TASK_PRIORITY=5
CONFIG_LVGL_TASK_STACK_SIZE=4096
CONFIG_LVGL_MSG_QUEUE_LEN=10

# 日志级别
CONFIG_LOG_DEFAULT_LEVEL_INFO=y
CONFIG_LOG_MAXIMUM_LEVEL_VERBOSE=y

# FreeRTOS
CONFIG_FREERTOS_HZ=1000
CONFIG_FREERTOS_UNICORE=n
CONFIG_FREERTOS_TASK_FUNCTION_WRAPPER=y

# NVS
CONFIG_NVS_ENCRYPTION=n
CONFIG_NVS_SECURITY_DEBUG=n

# Flash
CONFIG_ESPTOOLPY_FLASHSIZE_16MB=y
CONFIG_ESPTOOLPY_FLASHSIZE="16MB"
CONFIG_PARTITION_TABLE_CUSTOM=y

# USB CDC (用于日志)
CONFIG_ESP_CONSOLE_USB_SERIAL_JTAG=y

# 电源管理
CONFIG_PM_ENABLE=y
CONFIG_PM_DFS_INIT_AUTO=y

# Deep Sleep
CONFIG_ESP_SLEEP_GPIO_ENABLE=y
CONFIG_ESP_SLEEP_POWER_DOWN_GPIO=y

# 低功耗音频
CONFIG_ESP_LEGACY_SYSTIMER=y

# WebSocket transport buffer — Cloudflare sends large response headers (CF-Ray, nel, etc.)
# Default 1024 bytes is not enough; 4096 covers all auth + CF headers.
CONFIG_WS_BUFFER_SIZE=4096
```
